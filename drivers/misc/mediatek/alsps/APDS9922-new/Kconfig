## drivers/misc/mediatek/alsps/APDS9922-new/Kconfig
```kconfig
config MTK_APDS9922_NEW
	bool "APDS9922_NEW for GIONEE"
	default n
	help
	It support different type sensor
	in this platform. If this option
	is set, it will support ambient
	and light sensor APDS9922.
```
